## firmware_idf/components/ota_update/Kconfig
```kconfig
menu "GitHub OTA update"

config MOUSE_OTA_REPOSITORY
    string "Public GitHub owner/repository"
    default "nguyentriet0810/hid_mouse"
    help
        Published releases must provide esp32s3-n16r8.manifest and
        esp32s3-n16r8.bin. Private repository tokens are not embedded.

config MOUSE_OTA_WIFI_SSID
    string "Initial Wi-Fi SSID (local sdkconfig only)"
    default ""
    help
        Used only if OTA Wi-Fi credentials are missing from NVS. Credentials
        persist through OTA, so release binaries never need your password.
        Do not add local sdkconfig or credential files to Git.

config MOUSE_OTA_WIFI_PASSWORD
    string "Initial Wi-Fi password (local sdkconfig only)"
    default ""
    help
        Leave empty for an open network. Initial credentials are saved in
        the ota_net NVS namespace. NVS is not encrypted in this build.

config MOUSE_OTA_WIFI_REPLACE_STORED
    bool "Replace saved Wi-Fi credentials from this build on next OTA attempt"
    default n
    help
        Use with a non-empty initial SSID when changing networks. Normal
        release builds leave this disabled and retain existing credentials.

endmenu
```

## firmware_idf/main/Kconfig.projbuild
```kconfig
menu "ESP Mouse"

config MOUSE_DEVICE_NAME
    string "Bluetooth device name (1..20 ASCII characters)"
    default "ESP32 Air Mouse"
    help
        Name appears in the scan response. Keep it at most 20 ASCII characters.

config MOUSE_BLE_DIAGNOSTICS
    bool "Periodic BLE/HID runtime diagnostics"
    default n
    help
        Log link/security/subscription flags, motion/report counters and
        internal heap every ten seconds. Intended for bench diagnosis.
        Reports counted as accepted have been queued by the SDK; host
        receipt is not acknowledged by BLE notifications.

config MOUSE_DEADZONE_DEGREES
    int "Neutral deadzone in degrees"
    range 1 30
    default 6

config MOUSE_GAIN
    int "Pointer speed: pixels/second/degree outside deadzone"
    range 1 200
    default 45

config MOUSE_MAX_SPEED
    int "Maximum pointer speed in pixels/second"
    range 50 5000
    default 1300

config MOUSE_WHEEL_GAIN_TENTHS
    int "Wheel steps/second/degree, in tenths"
    range 1 100
    default 5

config MOUSE_INVERT_X
    bool "Reverse horizontal movement"
    default n

config MOUSE_INVERT_Y
    bool "Reverse vertical movement"
    default n

config MOUSE_BATTERY_LEVEL
    int "Development battery level (fixed value, not measured)"
    range 0 100
    default 99
    help
        The schematic has no battery ADC divider or fuel gauge. This fixed
        value preserves the old firmware's 99 percent placeholder. Replace
        with real measurement before relying on battery percentage.

config MOUSE_VENDOR_ID
    hex "Development PnP vendor ID"
    range 0x0000 0xFFFF
    default 0xFFFF
    help
        Placeholder for development. Set your assigned Bluetooth SIG vendor
        ID and update product/version before a production release.

endmenu
```

## firmware_idf/sdkconfig.defaults
```kconfig
CONFIG_IDF_TARGET="esp32s3"
CONFIG_ESPTOOLPY_FLASHSIZE_16MB=y
CONFIG_PARTITION_TABLE_CUSTOM=y
CONFIG_PARTITION_TABLE_CUSTOM_FILENAME="partitions.csv"
CONFIG_PARTITION_TABLE_OFFSET=0x8000
CONFIG_BOOTLOADER_APP_ROLLBACK_ENABLE=y
CONFIG_SPIRAM=y
CONFIG_SPIRAM_MODE_OCT=y
CONFIG_SPIRAM_TYPE_AUTO=y
CONFIG_SPIRAM_SPEED_80M=y
CONFIG_SPIRAM_BOOT_INIT=y
CONFIG_SPIRAM_MEMTEST=y
CONFIG_SPIRAM_USE_MALLOC=y
CONFIG_SPIRAM_MALLOC_RESERVE_INTERNAL=65536
CONFIG_MBEDTLS_CERTIFICATE_BUNDLE=y
CONFIG_MBEDTLS_CERTIFICATE_BUNDLE_DEFAULT_FULL=y
CONFIG_MBEDTLS_EXTERNAL_MEM_ALLOC=y
CONFIG_BT_ENABLED=y
CONFIG_BT_BLUEDROID_ENABLED=y
CONFIG_BT_BLE_ENABLED=y
CONFIG_BT_BLE_42_FEATURES_SUPPORTED=y
CONFIG_BT_GATTS_ENABLE=y
CONFIG_BT_GATTC_ENABLE=n
CONFIG_BT_BLE_SMP_ENABLE=y
CONFIG_BT_BLE_DYNAMIC_ENV_MEMORY=y
CONFIG_FREERTOS_HZ=1000
CONFIG_ESP_CONSOLE_USB_SERIAL_JTAG=y
CONFIG_ESP_MAIN_TASK_STACK_SIZE=12288
CONFIG_COMPILER_OPTIMIZATION_SIZE=y
CONFIG_COMPILER_STACK_CHECK_MODE_STRONG=y
CONFIG_LOG_DEFAULT_LEVEL_INFO=y
```
